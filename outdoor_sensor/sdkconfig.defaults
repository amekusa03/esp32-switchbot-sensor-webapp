## outdoor_sensor/sdkconfig.defaults
```kconfig
CONFIG_IDF_TARGET="esp32c3"
CONFIG_ESPTOOLPY_FLASHSIZE_4MB=y

# Power Management & Low Power
CONFIG_PM_ENABLE=y
CONFIG_FREERTOS_USE_TICKLESS_IDLE=y

# WiFi & ESP-NOW settings
CONFIG_ESP_WIFI_AMPDU_TX_ENABLED=n
CONFIG_ESP_WIFI_AMPDU_RX_ENABLED=n
```

## sdkconfig.defaults
```kconfig
CONFIG_IDF_TARGET="esp32c3"

# Custom Partition Table & Flash Size
CONFIG_PARTITION_TABLE_CUSTOM=y
CONFIG_PARTITION_TABLE_FILENAME="partitions.csv"
CONFIG_PARTITION_TABLE_OFFSET=0xC000
CONFIG_ESPTOOLPY_FLASHSIZE_4MB=y

# WiFi and Network
CONFIG_ESP_WIFI_SOFTAP_SUPPORT=y
CONFIG_ESP_WIFI_AMPDU_TX_ENABLED=y
CONFIG_ESP_WIFI_AMPDU_RX_ENABLED=y

# LwIP IPv6 & Matter Network Options
CONFIG_LWIP_IPV6_AUTOCONFIG=y
CONFIG_LWIP_HOOK_IP6_ROUTE_DEFAULT=y
CONFIG_LWIP_HOOK_ND6_GET_GW_DEFAULT=y
CONFIG_LWIP_IPV6_NUM_ADDRESSES=6

# Matter & Security Configuration
CONFIG_USE_MINIMAL_MDNS=n
CONFIG_ENABLE_CHIP_SHELL=y
CONFIG_MBEDTLS_HKDF_C=y
CONFIG_ENABLE_OTA_REQUESTOR=n

# HTTP Server Configuration
CONFIG_HTTPD_MAX_REQ_HDR_LEN=1024
CONFIG_HTTPD_MAX_URI_LEN=512

# HTTP Client / TLS
CONFIG_MBEDTLS_CERTIFICATE_BUNDLE=y
CONFIG_MBEDTLS_CERTIFICATE_BUNDLE_DEFAULT_FULL=y

# Main task stack size
CONFIG_ESP_MAIN_TASK_STACK_SIZE=8192

# Power Management
CONFIG_PM_ENABLE=y
CONFIG_FREERTOS_USE_TICKLESS_IDLE=y

# SNTP
CONFIG_LWIP_SNTP_MAX_SERVERS=2
```
